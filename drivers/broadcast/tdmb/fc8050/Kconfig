## drivers/broadcast/tdmb/fc8050/Kconfig
```kconfig
#
# LG2102_DEVICE subsystem configuration
#

#menu "FC8050 support"

config FC8050_TDMB
	default n
	---help---
	  This driver implements the front-end of the Xen virtual
	  keyboard and mouse device driver.  It communicates with a back-end
	  in another domain.

config FC8050_DEBUG
	default n
	---help---
	  Enable TDMB fc8050 debug messages.

#endmenu
```

## drivers/misc/tspdrv/Kconfig
```kconfig
#
# Immersion Touchsense vibrator
#

menu "Immersion Touchsense vibrator"

config TOUCHSENSE_VIBRATOR
	bool "Immersion Touchsense vibrator support"
	help
	  This option enables device driver support for Immersion Touchsense
	  vibrator.

config TOUCHSENSE_VIBRATOR_DEBUG
	bool "Immersion Touchsense vibrator debug option"
	depends on TOUCHSENSE_VIBRATOR
	default n
	help
	  Enable debug messages of Immersion Touchsense vibrator driver.

endmenu
```
